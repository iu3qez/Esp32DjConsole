// Auto-generated from reference/CATCommands.cs — DO NOT EDIT
// Run: python3 scripts/extract_cat_commands.py reference/CATCommands.cs --generate-c -o main/cmd_db_generated.inc
// Total: 328 commands

static const thetis_cmd_t s_cmd_db[] = {

    // ------ VFO (id 100+, 15 entries) ------
    {  100, "VFO A Tune", NULL, CAT_VFO       , CMD_CAT_FREQ    , "ZZFA", NULL  , 11,     0,     0 },
    {  101, "VFO B Tune", NULL, CAT_VFO       , CMD_CAT_FREQ    , "ZZFB", NULL  , 11,     0,     0 },
    {  112, "Multi Step VFO A", NULL, CAT_VFO       , CMD_CAT_WHEEL   , "UP", "DN"  ,  0,     0,     0 },
    {  113, "Sets VFO A up nn pre-set Steps", NULL, CAT_VFO       , CMD_CAT_SET     , "ZZAF", NULL  ,  2,     0,    99 },
    {  114, "Sets VFO B up nn pre-set Steps", NULL, CAT_VFO       , CMD_CAT_SET     , "ZZBF", NULL  ,  2,     0,    99 },
    {  115, "Andromeda front panel VFO encode...", "Andromeda front panel VFO encoder down write only", CAT_VFO       , CMD_CAT_SET     , "ZZZD", NULL  ,  3,     0,   100 },
    {  116, "Andromeda front panel VFO encode...", "Andromeda front panel VFO encoder up write only", CAT_VFO       , CMD_CAT_SET     , "ZZZU", NULL  ,  3,     0,   100 },
    {  117, "RTTY Offset Enable VFO A checkbox", "Sets or reads the RTTY Offset Enable VFO A checkbox", CAT_VFO       , CMD_CAT_TOGGLE  , "ZZRA", NULL  ,  1,     0,     1 },
    {  118, "RTTY Offset Enable VFO B checkbox", "Sets or reads the RTTY Offset Enable VFO B checkbox", CAT_VFO       , CMD_CAT_TOGGLE  , "ZZRB", NULL  ,  1,     0,     1 },
    {  119, "VFO Sync button status", "Reads or sets the VFO Sync button status", CAT_VFO       , CMD_CAT_TOGGLE  , "ZZSY", NULL  ,  1,     0,     1 },
    {  120, "VFO Lock button status", "Reads or sets the VFO Lock button status", CAT_VFO       , CMD_CAT_TOGGLE  , "ZZVL", NULL  ,  1,     0,     1 },
    {  121, "ZZUX", NULL, CAT_VFO       , CMD_CAT_TOGGLE  , "ZZUX", NULL  ,  1,     0,     1 },
    {  122, "ZZUY", NULL, CAT_VFO       , CMD_CAT_TOGGLE  , "ZZUY", NULL  ,  1,     0,     1 },
    {  123, "VFO swap status write only", "Sets the VFO swap status write only", CAT_VFO       , CMD_CAT_SET     , "ZZVS", NULL  ,  3,     0,   100 },
    {  124, "Swap vfo wheels, vfoA becomes vf...", "swap vfo wheels, vfoA becomes vfoB, B becomes A", CAT_VFO       , CMD_CAT_TOGGLE  , "ZZZW", NULL  ,  1,     0,     1 },

    // ------ BAND (id 200+, 20 entries) ------
    {  202, "160m", NULL, CAT_BAND      , CMD_CAT_BUTTON  , "ZZBS", NULL  ,  3,   160,   160 },
    {  203, "80m", NULL, CAT_BAND      , CMD_CAT_BUTTON  , "ZZBS", NULL  ,  3,    80,    80 },
    {  204, "60m", NULL, CAT_BAND      , CMD_CAT_BUTTON  , "ZZBS", NULL  ,  3,    60,    60 },
    {  205, "40m", NULL, CAT_BAND      , CMD_CAT_BUTTON  , "ZZBS", NULL  ,  3,    40,    40 },
    {  206, "30m", NULL, CAT_BAND      , CMD_CAT_BUTTON  , "ZZBS", NULL  ,  3,    30,    30 },
    {  207, "20m", NULL, CAT_BAND      , CMD_CAT_BUTTON  , "ZZBS", NULL  ,  3,    20,    20 },
    {  208, "17m", NULL, CAT_BAND      , CMD_CAT_BUTTON  , "ZZBS", NULL  ,  3,    17,    17 },
    {  209, "15m", NULL, CAT_BAND      , CMD_CAT_BUTTON  , "ZZBS", NULL  ,  3,    15,    15 },
    {  210, "12m", NULL, CAT_BAND      , CMD_CAT_BUTTON  , "ZZBS", NULL  ,  3,    12,    12 },
    {  211, "10m", NULL, CAT_BAND      , CMD_CAT_BUTTON  , "ZZBS", NULL  ,  3,    10,    10 },
    {  212, "6m", NULL, CAT_BAND      , CMD_CAT_BUTTON  , "ZZBS", NULL  ,  3,     6,     6 },
    {  213, "2m", NULL, CAT_BAND      , CMD_CAT_BUTTON  , "ZZBS", NULL  ,  3,     2,     2 },
    {  214, "Moves the RX2 bandswitch down on...", "Moves the RX2 bandswitch down one band", CAT_BAND      , CMD_CAT_BUTTON  , "ZZBA", NULL  ,  0,     0,     0 },
    {  215, "Moves the RX2 bandswitch up one ...", "Moves the RX2 bandswitch up one band", CAT_BAND      , CMD_CAT_BUTTON  , "ZZBB", NULL  ,  0,     0,     0 },
    {  216, "Moves the RX1 bandswitch down on...", "Moves the RX1 bandswitch down one band", CAT_BAND      , CMD_CAT_BUTTON  , "ZZBD", NULL  ,  0,     0,     0 },
    {  217, "Band Group (HF/VHF)", "Sets the Band Group (HF/VHF)", CAT_BAND      , CMD_CAT_TOGGLE  , "ZZBG", NULL  ,  1,     0,     1 },
    {  218, "Sets or gets the current RX2 ban...", "Sets or gets the current RX2 band setting", CAT_BAND      , CMD_CAT_SET     , "ZZBT", NULL  ,  3,     0,   100 },
    {  219, "Moves the bandswitch up one band", NULL, CAT_BAND      , CMD_CAT_BUTTON  , "ZZBU", NULL  ,  0,     0,     0 },
    {  220, "RX equalizer. The CAT suffix str...", "Reads or sets the RX equalizer. The CAT suffix string is 36 characters constant. Each value in the string occupies exactly three characters starting with the number of bands (003 or 010) followed by the preamp setting (-12 to 015) followed by 3 or 10 three digit EQ thumbwheel positions.  If the number of bands is 3, the last seven positions (21 characters) are all set to zero. Example:  10 band ZZEA010-09009005000-04-07-09-05000005009;", CAT_BAND      , CMD_CAT_SET     , "ZZEA", NULL  ,  3,     0,   100 },
    {  221, "XVTR Band Names", "Reads the XVTR Band Names", CAT_BAND      , CMD_CAT_BUTTON  , "ZZUA", NULL  ,  0,     0,     0 },

    // ------ MODE (id 300+, 21 entries) ------
    {  302, "LSB", NULL, CAT_MODE      , CMD_CAT_BUTTON  , "ZZMD", NULL  ,  2,     0,     0 },
    {  303, "USB", NULL, CAT_MODE      , CMD_CAT_BUTTON  , "ZZMD", NULL  ,  2,     1,     1 },
    {  304, "DSB", NULL, CAT_MODE      , CMD_CAT_BUTTON  , "ZZMD", NULL  ,  2,     2,     2 },
    {  305, "CW Lower", NULL, CAT_MODE      , CMD_CAT_BUTTON  , "ZZMD", NULL  ,  2,     3,     3 },
    {  306, "FM", NULL, CAT_MODE      , CMD_CAT_BUTTON  , "ZZMD", NULL  ,  2,     4,     4 },
    {  307, "AM", NULL, CAT_MODE      , CMD_CAT_BUTTON  , "ZZMD", NULL  ,  2,     5,     5 },
    {  308, "DIGL", NULL, CAT_MODE      , CMD_CAT_BUTTON  , "ZZMD", NULL  ,  2,     6,     6 },
    {  309, "CW Upper", NULL, CAT_MODE      , CMD_CAT_BUTTON  , "ZZMD", NULL  ,  2,     7,     7 },
    {  310, "SPEC", NULL, CAT_MODE      , CMD_CAT_BUTTON  , "ZZMD", NULL  ,  2,     8,     8 },
    {  311, "DIGU", NULL, CAT_MODE      , CMD_CAT_BUTTON  , "ZZMD", NULL  ,  2,     9,     9 },
    {  312, "SAM", NULL, CAT_MODE      , CMD_CAT_BUTTON  , "ZZMD", NULL  ,  2,    10,    10 },
    {  313, "DRM", NULL, CAT_MODE      , CMD_CAT_BUTTON  , "ZZMD", NULL  ,  2,    11,    11 },
    {  314, "Current display mode", "Sets or reads the current display mode", CAT_MODE      , CMD_CAT_SET     , "ZZDM", NULL  ,  3,     0,   100 },
    {  315, "Sends text to CWX for conversion...", "Sends text to CWX for conversion to Morse", CAT_MODE      , CMD_CAT_SET     , "ZZKY", NULL  ,  3,     0,   100 },
    {  316, "ZZME", NULL, CAT_MODE      , CMD_CAT_SET     , "ZZME", NULL  ,  3,     0,   100 },
    {  317, "RX meter mode", "Sets or reads the RX meter mode", CAT_MODE      , CMD_CAT_SET     , "ZZMR", NULL  ,  3,     0,   100 },
    {  318, "Current Antenna Mode", "Sets or reads the current Antenna Mode", CAT_MODE      , CMD_CAT_SET     , "ZZOD", NULL  ,  3,     0,   100 },
    {  319, "SDR-1000 Squelch control", "Sets or reads the SDR-1000 Squelch control", CAT_MODE      , CMD_CAT_SET     , "ZZSQ", NULL  ,  3,     0,   100 },
    {  320, "RX2 Squelch threshold", "Sets or reads the RX2 Squelch threshold", CAT_MODE      , CMD_CAT_SET     , "ZZSX", NULL  ,  3,     0,   100 },
    {  321, "Rx1/RX2 radio button in collapse...", "Sets or reads the Rx1/RX2 radio button in collapsed mode", CAT_MODE      , CMD_CAT_TOGGLE  , "ZZYR", NULL  ,  1,     0,     1 },
    {  322, "Zooms to band MW0LGE_21k9 depend...", "Zooms to band MW0LGE_21k9 depending on ztb mode 0 will recall 1 will store query will return 1 if ztb is set up as store/recall", CAT_MODE      , CMD_CAT_TOGGLE  , "ZZZT", NULL  ,  1,     0,     1 },

    // ------ TX (id 400+, 38 entries) ------
    {  400, "Sets VFO A down nn Tune Steps", NULL, CAT_TX        , CMD_CAT_SET     , "ZZAD", NULL  ,  2,     0,    25 },
    {  401, "Sets VFO A down nn Pre-set Tune ...", "Sets VFO A down nn Pre-set Tune Steps", CAT_TX        , CMD_CAT_SET     , "ZZAE", NULL  ,  2,     0,    99 },
    {  402, "APF tune", "Sets or reads the APF tune", CAT_TX        , CMD_CAT_SET     , "ZZAT", NULL  ,  3,  -250,   250 },
    {  403, "Sets VFO A up nn Tune Steps", NULL, CAT_TX        , CMD_CAT_SET     , "ZZAU", NULL  ,  2,     0,    14 },
    {  404, "Sets VFO B down nn Pre-set Tune ...", "Sets VFO B down nn Pre-set Tune Steps", CAT_TX        , CMD_CAT_SET     , "ZZBE", NULL  ,  2,     0,    99 },
    {  405, "Sets VFO B down nn Tune Steps", NULL, CAT_TX        , CMD_CAT_SET     , "ZZBM", NULL  ,  2,     0,    14 },
    {  406, "Sets VFO B up nn Tune Steps", NULL, CAT_TX        , CMD_CAT_SET     , "ZZBP", NULL  ,  2,     0,    14 },
    {  407, "TX EQ settings", "Sets or reads the TX EQ settings", CAT_TX        , CMD_CAT_SET     , "ZZEB", NULL  ,  3,     0,   100 },
    {  408, "TX frequency", "Sets or reads TX frequency", CAT_TX        , CMD_CAT_SET     , "ZZFT", NULL  ,  3,     0,   100 },
    {  409, "DSP Phone TX Buffer Size", "Sets or reads the DSP Phone TX Buffer Size", CAT_TX        , CMD_CAT_SET     , "ZZHT", NULL  ,  3,     0,   100 },
    {  410, "DSP Digital TX Buffer Size", "Sets or reads the DSP Digital TX Buffer Size", CAT_TX        , CMD_CAT_SET     , "ZZHX", NULL  ,  3,     0,   100 },
    {  411, "SDR-1000 transceiver status", "Reads the SDR-1000 transceiver status", CAT_TX        , CMD_CAT_SET     , "ZZIF", NULL  ,  3,     0,   100 },
    {  412, "AutoMute RX2 on VFOA TX checkbox", "Sets or reads the AutoMute RX2 on VFOA TX checkbox", CAT_TX        , CMD_CAT_SET     , "ZZLH", NULL  ,  3,     0,   100 },
    {  413, "ARIES ATU tune state message wri...", "ARIES ATU tune state message write only", CAT_TX        , CMD_CAT_SET     , "ZZOX", NULL  ,  3,     0,   100 },
    {  414, "TX meter mode", "Sets or reads the TX meter mode", CAT_TX        , CMD_CAT_SET     , "ZZMT", NULL  ,  3,     0,   100 },
    {  415, "TX antenna //[2.3.10.6]MW0LGE ht...", "Sets or reads the TX antenna //[2.3.10.6]MW0LGE https://github.com/ramdor/Thetis/issues/385", CAT_TX        , CMD_CAT_SET     , "ZZOC", NULL  ,  1,     1,     3 },
    {  416, "TX relay RCA jack", "Sets or reads the TX relay RCA jack", CAT_TX        , CMD_CAT_SET     , "ZZOF", NULL  ,  3,     0,   100 },
    {  417, "TX Relay Delay enables", "Sets or reads the TX Relay Delay enables", CAT_TX        , CMD_CAT_SET     , "ZZOG", NULL  ,  3,     0,   100 },
    {  418, "TX Relay Delays", "Sets or reads the TX Relay Delays", CAT_TX        , CMD_CAT_SET     , "ZZOH", NULL  ,  3,     0,   100 },
    {  419, "DigL Click Tune Offset", "Sets or reads the DigL Click Tune Offset", CAT_TX        , CMD_CAT_SET     , "ZZOL", NULL  ,  5,     0, 10000 },
    {  420, "DigU Click Tune Offset", "Sets or reads the DigU Click Tune Offset", CAT_TX        , CMD_CAT_SET     , "ZZOU", NULL  ,  5,     0, 10000 },
    {  421, "Drive level", "Sets or reads the Drive level", CAT_TX        , CMD_CAT_SET     , "ZZPC", NULL  ,  3,     0,   100 },
    {  422, "Console RX meter", "Reads the Console RX meter", CAT_TX        , CMD_CAT_SET     , "ZZRM", NULL  ,  3,     0,   100 },
    {  423, "Moves VFO A down one Tune Step", NULL, CAT_TX        , CMD_CAT_BUTTON  , "ZZSA", NULL  ,  0,     0,     0 },
    {  424, "Moves VFO A up one Tune Step", NULL, CAT_TX        , CMD_CAT_BUTTON  , "ZZSB", NULL  ,  0,     0,     0 },
    {  425, "Moves VFO B down one Tune Step", NULL, CAT_TX        , CMD_CAT_BUTTON  , "ZZSG", NULL  ,  0,     0,     0 },
    {  426, "Moves VFO B up one Tune Step", NULL, CAT_TX        , CMD_CAT_BUTTON  , "ZZSH", NULL  ,  0,     0,     0 },
    {  427, "Moves the mouse wheel step tune up", NULL, CAT_TX        , CMD_CAT_BUTTON  , "ZZSU", NULL  ,  0,     0,     0 },
    {  428, "Swaps VFO A/B TX buttons", NULL, CAT_TX        , CMD_CAT_TOGGLE  , "ZZSW", NULL  ,  1,     0,     1 },
    {  429, "Syncs the chosen vfo to the sele...", "Syncs the chosen vfo to the selected tune step write only", CAT_TX        , CMD_CAT_SET     , "ZZSZ", NULL  ,  3,     0,   100 },
    {  430, "Inhibits power output when using...", "Inhibits power output when using external antennas, tuners, etc.", CAT_TX        , CMD_CAT_TOGGLE  , "ZZTI", NULL  ,  1,     0,     1 },
    {  431, "TX Monitor level", "Sets or reads the TX Monitor level", CAT_TX        , CMD_CAT_SET     , "ZZTM", NULL  ,  3,     0,   100 },
    {  432, "Tune Power level", "Sets or reads the Tune Power level", CAT_TX        , CMD_CAT_SET     , "ZZTO", NULL  ,  3,     0,   100 },
    {  433, "TX Profile", "Sets or reads the TX Profile", CAT_TX        , CMD_CAT_SET     , "ZZTP", NULL  ,  3,     0,   100 },
    {  434, "MOX button status", "Sets or reads the MOX button status", CAT_TX        , CMD_CAT_TOGGLE  , "ZZTX", NULL  ,  1,     0,     1 },
    {  435, "VOX Enable button status", "Reads or sets the VOX Enable button status", CAT_TX        , CMD_CAT_TOGGLE  , "ZZVE", NULL  ,  1,     0,     1 },
    {  436, "Reads or set the VOX Delay control", NULL, CAT_TX        , CMD_CAT_SET     , "ZZXH", NULL  ,  4,     0,  4000 },
    {  437, "Reads VFO combined status", NULL, CAT_TX        , CMD_CAT_SET     , "ZZXV", NULL  ,  3,     0,   100 },

    // ------ AUDIO (id 500+, 21 entries) ------
    {  500, "APF gain (A for amplitude since ...", "Sets or reads the APF gain (A for amplitude since G is taken)", CAT_AUDIO     , CMD_CAT_SET     , "ZZAA", NULL  ,  3,     0,   100 },
    {  501, "SDR-1000 Audio Gain control", "Sets or reads the SDR-1000 Audio Gain control", CAT_AUDIO     , CMD_CAT_SET     , "ZZAG", NULL  ,  3,     0,   100 },
    {  502, "Diversity Form RX2 gain", "Sets or reads the Diversity Form RX2 gain", CAT_AUDIO     , CMD_CAT_SET     , "ZZDC", NULL  ,  4,     0,  5000 },
    {  503, "Diversity Form RX gain", "Sets or reads the Diversity Form RX gain", CAT_AUDIO     , CMD_CAT_SET     , "ZZDG", NULL  ,  4,     0,  1000 },
    {  504, "DX button status", "Sets or reads the DX button status", CAT_AUDIO     , CMD_CAT_SET     , "ZZDX", NULL  ,  3,     0,   100 },
    {  505, "RX1 (SubRX) Gain level", "Sets or reads the RX1 (SubRX) Gain level", CAT_AUDIO     , CMD_CAT_SET     , "ZZLC", NULL  ,  3,     0,   100 },
    {  506, "RX2 Gain level", "Sets or reads the RX2 Gain level", CAT_AUDIO     , CMD_CAT_SET     , "ZZLE", NULL  ,  3,     0,   100 },
    {  507, "MUT button on/off status", "Sets or reads the MUT button on/off status", CAT_AUDIO     , CMD_CAT_TOGGLE  , "ZZMA", NULL  ,  1,     0,     1 },
    {  508, "RX2 MUT button on/off status", "Sets or reads the RX2 MUT button on/off status", CAT_AUDIO     , CMD_CAT_TOGGLE  , "ZZMB", NULL  ,  1,     0,     1 },
    {  509, "Mic gain control", "Sets or reads the Mic gain control", CAT_AUDIO     , CMD_CAT_SET     , "ZZMG", NULL  ,  2,   -50,    70 },
    {  510, "Monitor (MON) button status", "Sets or reads the Monitor (MON) button status", CAT_AUDIO     , CMD_CAT_TOGGLE  , "ZZMO", NULL  ,  1,     0,     1 },
    {  511, "VAC RX Gain", "Sets or reads the VAC RX Gain", CAT_AUDIO     , CMD_CAT_SET     , "ZZVB", NULL  ,  2,   -40,    40 },
    {  512, "VAC TX Gain", "Sets or reads the VAC TX Gain", CAT_AUDIO     , CMD_CAT_SET     , "ZZVC", NULL  ,  2,   -40,    40 },
    {  513, "Reads or set the VOX Gain control", NULL, CAT_AUDIO     , CMD_CAT_SET     , "ZZVG", NULL  ,  4,     0,  1000 },
    {  514, "VAC2 TX Gain", "Sets or reads the VAC2 TX Gain", CAT_AUDIO     , CMD_CAT_SET     , "ZZVX", NULL  ,  2,   -40,    40 },
    {  515, "F5K Mixer Mic Gain", "Sets or reads the F5K Mixer Mic Gain", CAT_AUDIO     , CMD_CAT_SET     , "ZZWA", NULL  ,  3,     0,   100 },
    {  516, "F1500F5K Mixer Mic Selected Chec...", "Sets or reads the F1500F5K Mixer Mic Selected Checkbox", CAT_AUDIO     , CMD_CAT_SET     , "ZZWE", NULL  ,  3,     0,   100 },
    {  517, "F5K Mixer Mute All Checkbox", "Sets or reads the F5K Mixer Mute All Checkbox", CAT_AUDIO     , CMD_CAT_SET     , "ZZWJ", NULL  ,  3,     0,   100 },
    {  518, "F1500/F5K Mixer Output Mute All ...", "Sets or reads the F1500/F5K Mixer Output Mute All Checkbox", CAT_AUDIO     , CMD_CAT_SET     , "ZZWS", NULL  ,  3,     0,   100 },
    {  519, "F1500 mixer form mic level", "Reads or sets the F1500 mixer form mic level", CAT_AUDIO     , CMD_CAT_SET     , "ZZWT", NULL  ,  3,     0,   100 },
    {  520, "FM mic gain", "Reads or sets the FM mic gain", CAT_AUDIO     , CMD_CAT_SET     , "ZZYC", NULL  ,  2,     0,    70 },

    // ------ FILTER (id 600+, 21 entries) ------
    {  604, "Filter High Wheel", NULL, CAT_FILTER    , CMD_CAT_WHEEL   , "ZZHU", "ZZHD",  0,     0,     0 },
    {  606, "RX2 Filter Wider", NULL, CAT_FILTER    , CMD_CAT_BUTTON  , "ZZFV", NULL  ,  0,     0,     0 },
    {  607, "RX2 Filter Narrower", NULL, CAT_FILTER    , CMD_CAT_BUTTON  , "ZZFX", NULL  ,  0,     0,     0 },
    {  608, "TX Filter High Whl", NULL, CAT_FILTER    , CMD_CAT_WHEEL   , "ZZHW", "ZZHX",  0,     0,     0 },
    {  609, "TX Filter Low Whl", NULL, CAT_FILTER    , CMD_CAT_WHEEL   , "ZZLG", "ZZLH",  0,     0,     0 },
    {  626, "Filter Width", NULL, CAT_FILTER    , CMD_CAT_FILTER_WIDTH, "ZZSF", NULL  ,  8,    50,  6000 },
    {  627, "Current filter index number", "Sets or reads the current filter index number", CAT_FILTER    , CMD_CAT_SET     , "ZZFI", NULL  ,  3,     0,   100 },
    {  628, "Current RX2 DSP filter", "Sets or reads the current RX2 DSP filter", CAT_FILTER    , CMD_CAT_SET     , "ZZFJ", NULL  ,  3,     0,   100 },
    {  629, "DSP Filter Low value", "Reads or sets the DSP Filter Low value", CAT_FILTER    , CMD_CAT_SET     , "ZZFL", NULL  ,  5, -10000, 10000 },
    {  630, "DSP Filter High value", "Reads or sets the DSP Filter High value", CAT_FILTER    , CMD_CAT_SET     , "ZZFH", NULL  ,  5, -10000, 10000 },
    {  631, "RX2 DSP Filter High value", "Reads or sets the RX2 DSP Filter High value", CAT_FILTER    , CMD_CAT_SET     , "ZZFR", NULL  ,  5, -10000, 10000 },
    {  632, "RX2 DSP Filter Low value", "Reads or sets the RX2 DSP Filter Low value", CAT_FILTER    , CMD_CAT_SET     , "ZZFS", NULL  ,  5, -10000, 10000 },
    {  633, "IF width", "Sets or reads the IF width", CAT_FILTER    , CMD_CAT_SET     , "ZZIS", NULL  ,  3,     0,   100 },
    {  634, "IF Shift", "Sets or reads the IF Shift", CAT_FILTER    , CMD_CAT_SET     , "ZZIT", NULL  ,  3,     0,   100 },
    {  635, "Resets the Filter Shift to zero....", "Resets the Filter Shift to zero.  Write only", CAT_FILTER    , CMD_CAT_BUTTON  , "ZZIU", NULL  ,  0,     0,     0 },
    {  636, "DSP filter presets for filter in...", "Reads the DSP filter presets for filter index (s) Returns 180 character length word for 12 filters x 15 characters each. Format is name high low: ZZMN 5.0k 5150 -160...", CAT_FILTER    , CMD_CAT_SET     , "ZZMN", NULL  ,  3,     0,   100 },
    {  637, "Saves the current radio configur...", "Saves the current radio configuration to a new memory channel", CAT_FILTER    , CMD_CAT_BUTTON  , "ZZMY", NULL  ,  0,     0,     0 },
    {  638, "Saves the radio configuration to...", "Saves the radio configuration to a specific channel number (edit)", CAT_FILTER    , CMD_CAT_SET     , "ZZMZ", NULL  ,  3,     0,   100 },
    {  639, "Show TX Filter checkbox", "Sets or reads the Show TX Filter checkbox", CAT_FILTER    , CMD_CAT_TOGGLE  , "ZZTF", NULL  ,  1,     0,     1 },
    {  640, "TX filter high setting", "Sets or reads the TX filter high setting", CAT_FILTER    , CMD_CAT_SET     , "ZZTH", NULL  ,  5,   500, 20000 },
    {  641, "TX filter low setting", "Sets or reads the TX filter low setting", CAT_FILTER    , CMD_CAT_SET     , "ZZTL", NULL  ,  4,     0,  2000 },

    // ------ NR_NB (id 700+, 15 entries) ------
    {  700, "Noise gate enable button status", "Sets or reads the noise gate enable button status", CAT_NR_NB     , CMD_CAT_TOGGLE  , "ZZGE", NULL  ,  1,     0,     1 },
    {  701, "Noise gate level control", "Sets or reads the noise gate level control", CAT_NR_NB     , CMD_CAT_SET     , "ZZGL", NULL  ,  3,     0,   100 },
    {  702, "Noise Blanker 2 status", "Sets or reads Noise Blanker 2 status", CAT_NR_NB     , CMD_CAT_TOGGLE  , "ZZNA", NULL  ,  1,     0,     1 },
    {  703, "Noise Blanker 2 status", "Sets or reads the Noise Blanker 2 status", CAT_NR_NB     , CMD_CAT_TOGGLE  , "ZZNB", NULL  ,  1,     0,     1 },
    {  704, "RX2 NB status", "Sets or reads the RX2 NB status", CAT_NR_NB     , CMD_CAT_TOGGLE  , "ZZNC", NULL  ,  1,     0,     1 },
    {  705, "Noise Blanker 1 threshold", "Sets or reads the Noise Blanker 1 threshold", CAT_NR_NB     , CMD_CAT_SET     , "ZZNL", NULL  ,  3,     0,   100 },
    {  706, "Noise Blanker 2 threshold", "Sets or reads the Noise Blanker 2 threshold", CAT_NR_NB     , CMD_CAT_SET     , "ZZNM", NULL  ,  3,     0,   100 },
    {  707, "Rx1 Spectral Noise Blanker", "Sets or reads the Rx1 Spectral Noise Blanker", CAT_NR_NB     , CMD_CAT_TOGGLE  , "ZZNN", NULL  ,  1,     0,     1 },
    {  708, "Rx2 Spectral Noise Blanker", "Sets or reads the Rx2 Spectral Noise Blanker", CAT_NR_NB     , CMD_CAT_TOGGLE  , "ZZNO", NULL  ,  1,     0,     1 },
    {  709, "RX1 Noise Reduction status", "Sets or reads the RX1 Noise Reduction status", CAT_NR_NB     , CMD_CAT_TOGGLE  , "ZZNR", NULL  ,  1,     0,     1 },
    {  710, "RX1 Noise Reduction status retur...", "Sets or reads the RX1 Noise Reduction status returns 0 for off, 1,2,3,4 depending on NR in use", CAT_NR_NB     , CMD_CAT_TOGGLE  , "ZZNE", NULL  ,  1,     0,     1 },
    {  711, "RX2 Noise Reduction status retur...", "Sets or reads the RX2 Noise Reduction status returns 0 for off, 1,2,3,4 depending on NR in use", CAT_NR_NB     , CMD_CAT_TOGGLE  , "ZZNF", NULL  ,  1,     0,     1 },
    {  712, "ANF button status", "Sets or reads the ANF button status", CAT_NR_NB     , CMD_CAT_TOGGLE  , "ZZNT", NULL  ,  1,     0,     1 },
    {  713, "RX2 ANF button status", "Sets or reads the RX2 ANF button status", CAT_NR_NB     , CMD_CAT_TOGGLE  , "ZZNU", NULL  ,  1,     0,     1 },
    {  714, "Noise Reduction status", "Sets or reads the Noise Reduction status", CAT_NR_NB     , CMD_CAT_TOGGLE  , "ZZNV", NULL  ,  1,     0,     1 },

    // ------ AGC (id 800+, 4 entries) ------
    {  800, "AGC RF gain", "Sets or reads the AGC RF gain", CAT_AGC       , CMD_CAT_SET     , "ZZAR", NULL  ,  3,   -20,   120 },
    {  801, "RX2 AGC-T", "Sets or reads the RX2 AGC-T", CAT_AGC       , CMD_CAT_SET     , "ZZAS", NULL  ,  3,   -20,   120 },
    {  802, "AGC constant", "Sets or reads the AGC constant", CAT_AGC       , CMD_CAT_SET     , "ZZGT", NULL  ,  3,     0,   100 },
    {  803, "RX2 AGC constant", "Sets or reads the RX2 AGC constant", CAT_AGC       , CMD_CAT_SET     , "ZZGU", NULL  ,  3,     0,   100 },

    // ------ SPLIT_RIT (id 900+, 10 entries) ------
    {  908, "Clears the RIT frequency", NULL, CAT_SPLIT_RIT , CMD_CAT_BUTTON  , "ZZRC", NULL  ,  0,     0,     0 },
    {  909, "RIT frequency value", "Sets or reads the RIT frequency value", CAT_SPLIT_RIT , CMD_CAT_SET     , "ZZRF", NULL  ,  5, -99999, 99999 },
    {  910, "RIT button status", "Sets or reads the RIT button status", CAT_SPLIT_RIT , CMD_CAT_TOGGLE  , "ZZRT", NULL  ,  1,     0,     1 },
    {  911, "VFO Split status", "Sets or reads the VFO Split status", CAT_SPLIT_RIT , CMD_CAT_TOGGLE  , "ZZSP", NULL  ,  1,     0,     1 },
    {  912, "Transmit VFO frequency when in s...", "Sets or reads the transmit VFO frequency when in split with RX2 enabled", CAT_SPLIT_RIT , CMD_CAT_SET     , "ZZTV", NULL  ,  3,     0,   100 },
    {  913, "Clears the XIT frequency write only", NULL, CAT_SPLIT_RIT , CMD_CAT_BUTTON  , "ZZXC", NULL  ,  0,     0,     0 },
    {  914, "XIT frequency value", "Sets or reads the XIT frequency value", CAT_SPLIT_RIT , CMD_CAT_SET     , "ZZXF", NULL  ,  5, -99999, 99999 },
    {  915, "XIT button status", "Sets or reads the XIT button status", CAT_SPLIT_RIT , CMD_CAT_TOGGLE  , "ZZXS", NULL  ,  1,     0,     1 },
    {  916, "[2.10.1.0]MW0LGE enable/disable ...", "[2.10.1.0]MW0LGE enable/disable quick split mode", CAT_SPLIT_RIT , CMD_CAT_TOGGLE  , "ZZZN", NULL  ,  1,     0,     1 },
    {  917, "[2.10.1.0]MW0LGE enable/disable ...", "[2.10.1.0]MW0LGE enable/disable quick split and turn split on/off at same time", CAT_SPLIT_RIT , CMD_CAT_TOGGLE  , "ZZZO", NULL  ,  1,     0,     1 },

    // ------ CW (id 1000+, 11 entries) ------
    { 1003, "CW Speed Inc", NULL, CAT_CW        , CMD_CAT_WHEEL   , "ZZCU", "ZZCD",  0,     0,     0 },
    { 1004, "CW Break In Enabled checkbox", "Sets or reads the CW Break In Enabled checkbox", CAT_CW        , CMD_CAT_TOGGLE  , "ZZCB", NULL  ,  1,     0,     1 },
    { 1005, "CW Break In Delay", "Sets or reads the CW Break In Delay", CAT_CW        , CMD_CAT_SET     , "ZZCD", NULL  ,  4,   150,  5000 },
    { 1006, "Show CW Frequency checkbox", "Sets or reads the Show CW Frequency checkbox", CAT_CW        , CMD_CAT_TOGGLE  , "ZZCF", NULL  ,  1,     0,     1 },
    { 1007, "CW Iambic checkbox", "Sets or reads the CW Iambic checkbox", CAT_CW        , CMD_CAT_TOGGLE  , "ZZCI", NULL  ,  1,     0,     1 },
    { 1008, "CW Pitch thumbwheel", "Sets or reads the CW Pitch thumbwheel", CAT_CW        , CMD_CAT_SET     , "ZZCL", NULL  ,  3,     0,   100 },
    { 1009, "CW Monitor Disable button status", "Sets or reads the CW Monitor Disable button status", CAT_CW        , CMD_CAT_TOGGLE  , "ZZCM", NULL  ,  1,     0,     1 },
    { 1010, "CW Speed thumbwheel", "Sets or reads the CW Speed thumbwheel", CAT_CW        , CMD_CAT_SET     , "ZZCS", NULL  ,  3,     0,   100 },
    { 1011, "DSP CW TX Buffer Size", "Sets or reads the DSP CW TX Buffer Size", CAT_CW        , CMD_CAT_SET     , "ZZHV", NULL  ,  3,     0,   100 },
    { 1012, "CWX CW speed", "Sets or reads the CWX CW speed", CAT_CW        , CMD_CAT_SET     , "ZZKS", NULL  ,  2,     1,    99 },
    { 1013, "CW Break-In for Semi/QSK modes", "Sets or reads the CW Break-In for Semi/QSK modes", CAT_CW        , CMD_CAT_TOGGLE  , "ZZQK", NULL  ,  1,     0,     1 },

    // ------ MISC (id 1100+, 152 entries) ------
    { 1111, "Zoom Inc", NULL, CAT_MISC      , CMD_CAT_WHEEL   , "ZZZA", "ZZZB",  0,     0,     0 },
    { 1112, "APF bandwidth", "Sets or reads the APF bandwidth", CAT_MISC      , CMD_CAT_SET     , "ZZAB", NULL  ,  3,    10,   150 },
    { 1113, "Console step size (also see zzst...", "Sets or reads the console step size (also see zzst(read only)", CAT_MISC      , CMD_CAT_SET     , "ZZAC", NULL  ,  2,     0,    25 },
    { 1114, "ZZAI", NULL, CAT_MISC      , CMD_CAT_SET     , "ZZAI", NULL  ,  3,     0,   100 },
    { 1115, "APF button on/off status", "Sets or reads the APF button on/off status", CAT_MISC      , CMD_CAT_TOGGLE  , "ZZAP", NULL  ,  1,     0,     1 },
    { 1116, "BIN button status", "Sets or reads the BIN button status", CAT_MISC      , CMD_CAT_TOGGLE  , "ZZBI", NULL  ,  1,     0,     1 },
    { 1117, "BCI Rejection button status", "Sets or reads the BCI Rejection button status", CAT_MISC      , CMD_CAT_TOGGLE  , "ZZBR", NULL  ,  1,     0,     1 },
    { 1118, "Shuts down the console", NULL, CAT_MISC      , CMD_CAT_BUTTON  , "ZZBY", NULL  ,  0,     0,     0 },
    { 1119, "CTUN for RX1", "Sets or reads CTUN for RX1", CAT_MISC      , CMD_CAT_TOGGLE  , "ZZCN", NULL  ,  1,     0,     1 },
    { 1120, "CTUN for RX2", "Sets or reads CTUN for RX2", CAT_MISC      , CMD_CAT_TOGGLE  , "ZZCO", NULL  ,  1,     0,     1 },
    { 1121, "Compander button status", "Sets or reads the compander button status", CAT_MISC      , CMD_CAT_TOGGLE  , "ZZCP", NULL  ,  1,     0,     1 },
    { 1122, "Compander threshold", "Reads or sets the compander threshold", CAT_MISC      , CMD_CAT_SET     , "ZZCT", NULL  ,  3,     0,   100 },
    { 1123, "Display Average status", "Sets or reads the Display Average status", CAT_MISC      , CMD_CAT_TOGGLE  , "ZZDA", NULL  ,  1,     0,     1 },
    { 1124, "Diversity Form RX Reference radi...", "Sets or reads the Diversity Form RX Reference radio buttons", CAT_MISC      , CMD_CAT_TOGGLE  , "ZZDB", NULL  ,  1,     0,     1 },
    { 1125, "Diversity Form phase", "Sets or reads the Diversity Form phase", CAT_MISC      , CMD_CAT_SET     , "ZZDD", NULL  ,  5, -18000, 18000 },
    { 1126, "Diversity Form Enable Button", "Sets or reads the Diversity Form Enable Button", CAT_MISC      , CMD_CAT_TOGGLE  , "ZZDE", NULL  ,  1,     0,     1 },
    { 1127, "Opens or closes the Diversity Form", NULL, CAT_MISC      , CMD_CAT_TOGGLE  , "ZZDF", NULL  ,  1,     0,     1 },
    { 1128, "Diversity Form RX Source radio b...", "Sets or reads the Diversity Form RX Source radio buttons", CAT_MISC      , CMD_CAT_TOGGLE  , "ZZDH", NULL  ,  1,     0,     1 },
    { 1129, "Setup form Waterfall Low value", "Reads or sets the setup form Waterfall Low value", CAT_MISC      , CMD_CAT_SET     , "ZZDN", NULL  ,  3,     0,   100 },
    { 1130, "Setup form Waterfall High value", "Reads or sets the setup form Waterfall High value", CAT_MISC      , CMD_CAT_SET     , "ZZDO", NULL  ,  3,     0,   100 },
    { 1131, "Setup form Spectrum Grid Max Value", "Reads or sets the setup form Spectrum Grid Max Value", CAT_MISC      , CMD_CAT_SET     , "ZZDP", NULL  ,  3,     0,   100 },
    { 1132, "Setup form Spectrum Grid Min Value", "Reads or sets the setup form Spectrum Grid Min Value", CAT_MISC      , CMD_CAT_SET     , "ZZDQ", NULL  ,  3,     0,   100 },
    { 1133, "Spectrum Grid Step", "Sets or reads the Spectrum Grid Step", CAT_MISC      , CMD_CAT_SET     , "ZZDR", NULL  ,  3,     0,   100 },
    { 1134, "Constructs the state word for DD...", "Constructs the state word for DDUtil read only", CAT_MISC      , CMD_CAT_BUTTON  , "ZZDU", NULL  ,  0,     0,     0 },
    { 1135, "ZZDY", NULL, CAT_MISC      , CMD_CAT_SET     , "ZZDY", NULL  ,  2,     0,    10 },
    { 1136, "Provides verbose CAT error repor...", "Provides verbose CAT error reporting", CAT_MISC      , CMD_CAT_TOGGLE  , "ZZEM", NULL  ,  1,     0,     1 },
    { 1137, "RXEQ button statusl", "Sets or reads the RXEQ button statusl", CAT_MISC      , CMD_CAT_TOGGLE  , "ZZER", NULL  ,  1,     0,     1 },
    { 1138, "TXEQ button status", "Sets or reads the TXEQ button status", CAT_MISC      , CMD_CAT_TOGGLE  , "ZZET", NULL  ,  1,     0,     1 },
    { 1139, "Selects or reads the FM deviatio...", "Selects or reads the FM deviation radio button", CAT_MISC      , CMD_CAT_SET     , "ZZFD", NULL  ,  3,     0,   100 },
    { 1140, "ZZFM", NULL, CAT_MISC      , CMD_CAT_BUTTON  , "ZZFM", NULL  ,  0,     0,     0 },
    { 1141, "Reds FlexWire double byte value ...", "Reds FlexWire double byte value commands", CAT_MISC      , CMD_CAT_SET     , "ZZFW", NULL  ,  3,     0,   100 },
    { 1142, "Sends FlexWire double byte value...", "Sends FlexWire double byte value commands", CAT_MISC      , CMD_CAT_SET     , "ZZFY", NULL  ,  3,     0,   100 },
    { 1143, "Audio Buffer Size", "Sets or reads the Audio Buffer Size", CAT_MISC      , CMD_CAT_SET     , "ZZHA", NULL  ,  3,     0,   100 },
    { 1144, "DSP Phone RX Buffer Size", "Sets or reads the DSP Phone RX Buffer Size", CAT_MISC      , CMD_CAT_SET     , "ZZHR", NULL  ,  3,     0,   100 },
    { 1145, "CAT Rig Type to SDR-1000 Modifie...", "Sets the CAT Rig Type to SDR-1000 Modified 10/12/08 BT changed \"SDR-1000\" to \"PowerSDR\"", CAT_MISC      , CMD_CAT_BUTTON  , "ZZID", NULL  ,  0,     0,     0 },
    { 1146, "Installed options", "Reads the installed options", CAT_MISC      , CMD_CAT_BUTTON  , "ZZIO", NULL  ,  0,     0,     0 },
    { 1147, "ZZKO", NULL, CAT_MISC      , CMD_CAT_TOGGLE  , "ZZKO", NULL  ,  1,     0,     1 },
    { 1148, "Sends a CWX macro", NULL, CAT_MISC      , CMD_CAT_SET     , "ZZKM", NULL  ,  3,     0,   100 },
    { 1149, "RX0Gain level", "Sets or reads the RX0Gain level", CAT_MISC      , CMD_CAT_SET     , "ZZLA", NULL  ,  3,     0,   100 },
    { 1150, "RX0 (Main RX) stereo balance", "Sets or reads the RX0 (Main RX) stereo balance", CAT_MISC      , CMD_CAT_SET     , "ZZLB", NULL  ,  3,     0,   100 },
    { 1151, "RX1 (Sub RX) stereo balance", "Sets or reads the RX1 (Sub RX) stereo balance", CAT_MISC      , CMD_CAT_SET     , "ZZLD", NULL  ,  3,     0,   100 },
    { 1152, "RX2 stereo balance", "Sets or reads the RX2 stereo balance", CAT_MISC      , CMD_CAT_SET     , "ZZLF", NULL  ,  3,     0,   100 },
    { 1153, "PS-A button on/off status", "Sets or reads the PS-A button on/off status", CAT_MISC      , CMD_CAT_TOGGLE  , "ZZLI", NULL  ,  1,     0,     1 },
    { 1154, "ZZMFcccccccccccccccccccc;  Set m...", "ZZMFcccccccccccccccccccc;  Set multifunction encoder text cc are 15 pairs of digits 0-99 each making up an ASCII code -32 (so  'A' is 33 for example)", CAT_MISC      , CMD_CAT_SET     , "ZZMF", NULL  ,  3,     0,   100 },
    { 1155, "Andromeda front panel s/w versio...", "Andromeda front panel s/w version write only", CAT_MISC      , CMD_CAT_SET     , "ZZZS", NULL  ,  3,     0,   100 },
    { 1156, "Andromeda front panel encoder st...", "Andromeda front panel encoder step write only", CAT_MISC      , CMD_CAT_SET     , "ZZZE", NULL  ,  3,     0,   100 },
    { 1157, "Andromeda front panel pushbutton...", "Andromeda front panel pushbutton press write only", CAT_MISC      , CMD_CAT_SET     , "ZZZP", NULL  ,  3,     0,   100 },
    { 1158, "ARIES ATU erase state message wr...", "ARIES ATU erase state message write only", CAT_MISC      , CMD_CAT_SET     , "ZZOZ", NULL  ,  3,     0,   100 },
    { 1159, "Returns a list of modes with index", NULL, CAT_MISC      , CMD_CAT_BUTTON  , "ZZML", NULL  ,  0,     0,     0 },
    { 1160, "MultiRX Swap checkbox", "Sets or reads the MultiRX Swap checkbox", CAT_MISC      , CMD_CAT_TOGGLE  , "ZZMS", NULL  ,  1,     0,     1 },
    { 1161, "MultiRX button status", "Sets or reads the MultiRX button status", CAT_MISC      , CMD_CAT_TOGGLE  , "ZZMU", NULL  ,  1,     0,     1 },
    { 1162, "Returns the count of memory reco...", "Returns the count of memory records read only", CAT_MISC      , CMD_CAT_BUTTON  , "ZZMV", NULL  ,  0,     0,     0 },
    { 1163, "Deletes a memory channel", NULL, CAT_MISC      , CMD_CAT_SET     , "ZZMW", NULL  ,  3,     0,   100 },
    { 1164, "Restores memory channel n", NULL, CAT_MISC      , CMD_CAT_SET     , "ZZMX", NULL  ,  3,     0,   100 },
    { 1165, "RX2 NB2 status", "Sets or reads the RX2 NB2 status", CAT_MISC      , CMD_CAT_TOGGLE  , "ZZND", NULL  ,  1,     0,     1 },
    { 1166, "RX1 NR2 button status", "Sets or reads the RX1 NR2 button status", CAT_MISC      , CMD_CAT_TOGGLE  , "ZZNS", NULL  ,  1,     0,     1 },
    { 1167, "RX1 NR4 reduction amount, suppli...", "Sets the RX1 NR4 reduction amount, supplied as int from 0 to 100, then converted to 0-20dB", CAT_MISC      , CMD_CAT_SET     , "ZZNG", NULL  ,  3,     0,   100 },
    { 1168, "RX1 NR4 reduction amount, suppli...", "Sets the RX1 NR4 reduction amount, supplied as int from 0 to 100, then converted to 0-20dB", CAT_MISC      , CMD_CAT_SET     , "ZZNH", NULL  ,  3,     0,   100 },
    { 1169, "RX2 NR2 button status", "Sets or reads the RX2 NR2 button status", CAT_MISC      , CMD_CAT_TOGGLE  , "ZZNW", NULL  ,  1,     0,     1 },
    { 1170, "RX1 antenna //[2.3.10.6]MW0LGE h...", "Sets or reads the RX1 antenna //[2.3.10.6]MW0LGE https://github.com/ramdor/Thetis/issues/385", CAT_MISC      , CMD_CAT_SET     , "ZZOA", NULL  ,  1,     1,     3 },
    { 1171, "RX2 antenna (if RX2 installed)", "Sets or reads the RX2 antenna (if RX2 installed)", CAT_MISC      , CMD_CAT_SET     , "ZZOB", NULL  ,  3,     0,   100 },
    { 1172, "RX1 External Antenna checkbox", "Sets or reads the RX1 External Antenna checkbox", CAT_MISC      , CMD_CAT_SET     , "ZZOE", NULL  ,  3,     0,   100 },
    { 1173, "ZZOJ", NULL, CAT_MISC      , CMD_CAT_SET     , "ZZOJ", NULL  ,  3,     0,   100 },
    { 1174, "Current repeater offset direction", "Sets or reads the current repeater offset direction", CAT_MISC      , CMD_CAT_SET     , "ZZOS", NULL  ,  3,     0,   100 },
    { 1175, "Sets for reads the repeater freq...", "Sets for reads the repeater frequency offset need to resolve the negative offset question.", CAT_MISC      , CMD_CAT_SET     , "ZZOT", NULL  ,  3,     0,   100 },
    { 1176, "Console ATU button", "Sets or reads the console ATU button", CAT_MISC      , CMD_CAT_SET     , "ZZOV", NULL  ,  3,     0,   100 },
    { 1177, "Console ATU Bypass button", "Sets or reads the console ATU Bypass button", CAT_MISC      , CMD_CAT_SET     , "ZZOW", NULL  ,  3,     0,   100 },
    { 1178, "Preamp thumbwheel", "Sets or reads the Preamp thumbwheel", CAT_MISC      , CMD_CAT_SET     , "ZZPA", NULL  ,  3,     0,   100 },
    { 1179, "RX2 Preamp button", "Sets or reads the RX2 Preamp button", CAT_MISC      , CMD_CAT_SET     , "ZZPB", NULL  ,  3,     0,   100 },
    { 1180, "Centers the Display Pan scroll", NULL, CAT_MISC      , CMD_CAT_BUTTON  , "ZZPD", NULL  ,  0,     0,     0 },
    { 1181, "Display Pan control", "Sets or reads the Display Pan control", CAT_MISC      , CMD_CAT_SET     , "ZZPE", NULL  ,  4,     0,  1000 },
    { 1182, "ZZPK", NULL, CAT_MISC      , CMD_CAT_TOGGLE  , "ZZPK", NULL  ,  1,     0,     1 },
    { 1183, "ZZPL", NULL, CAT_MISC      , CMD_CAT_SET     , "ZZPL", NULL  ,  3,     0,   100 },
    { 1184, "ZZPL", NULL, CAT_MISC      , CMD_CAT_SET     , "ZZPL", NULL  ,  3,     0,   100 },
    { 1185, "Display Peak button status", "Sets or reads the Display Peak button status", CAT_MISC      , CMD_CAT_SET     , "ZZPO", NULL  ,  3,     0,   100 },
    { 1186, "Power button status", "Sets or reads the Power button status", CAT_MISC      , CMD_CAT_TOGGLE  , "ZZPS", NULL  ,  1,     0,     1 },
    { 1187, "Display Zoom control", "Sets or reads the Display Zoom control", CAT_MISC      , CMD_CAT_SET     , "ZZPY", NULL  ,  3,    10,   240 },
    { 1188, "Display Zoom buttons", "Sets the Display Zoom buttons", CAT_MISC      , CMD_CAT_SET     , "ZZPZ", NULL  ,  3,     0,   100 },
    { 1189, "Quick Memory Save value", "Reads the Quick Memory Save value", CAT_MISC      , CMD_CAT_BUTTON  , "ZZQM", NULL  ,  0,     0,     0 },
    { 1190, "Recalls Memory Quick Save", NULL, CAT_MISC      , CMD_CAT_BUTTON  , "ZZQR", NULL  ,  0,     0,     0 },
    { 1191, "Saves Quick Memory value", NULL, CAT_MISC      , CMD_CAT_BUTTON  , "ZZQS", NULL  ,  0,     0,     0 },
    { 1192, "RTTY DIGH offset frequency ud co...", "Sets or reads the RTTY DIGH offset frequency ud counter", CAT_MISC      , CMD_CAT_SET     , "ZZRH", NULL  ,  4, -3000,  3000 },
    { 1193, "RTTY DIGL offset frequency ud co...", "Sets or reads the RTTY DIGL offset frequency ud counter", CAT_MISC      , CMD_CAT_SET     , "ZZRL", NULL  ,  4, -3000,  3000 },
    { 1194, "RX2 button status", "Sets or reads the RX2 button status", CAT_MISC      , CMD_CAT_TOGGLE  , "ZZRS", NULL  ,  1,     0,     1 },
    { 1195, "Primary input voltage", "Reads the primary input voltage", CAT_MISC      , CMD_CAT_BUTTON  , "ZZRV", NULL  ,  0,     0,     0 },
    { 1196, "RX1 step attenuation control, 0 ...", "Sets or reads the RX1 step attenuation control, 0 to 31dB", CAT_MISC      , CMD_CAT_SET     , "ZZRX", NULL  ,  2,     0,    31 },
    { 1197, "RX2 step attenuation control, 0 ...", "Sets or reads the RX2 step attenuation control, 0 to 31dB", CAT_MISC      , CMD_CAT_SET     , "ZZRY", NULL  ,  2,     0,    31 },
    { 1198, "Moves the mouse wheel tuning ste...", "Moves the mouse wheel tuning step down", CAT_MISC      , CMD_CAT_BUTTON  , "ZZSD", NULL  ,  0,     0,     0 },
    { 1199, "S Meter value", "Reads the S Meter value", CAT_MISC      , CMD_CAT_TOGGLE  , "ZZSM", NULL  ,  1,     0,     1 },
    { 1200, "Radio serial number", "Reads the radio serial number", CAT_MISC      , CMD_CAT_BUTTON  , "ZZSN", NULL  ,  0,     0,     0 },
    { 1201, "Squelch on/off status", "Sets or reads the Squelch on/off status", CAT_MISC      , CMD_CAT_TOGGLE  , "ZZSO", NULL  ,  1,     0,     1 },
    { 1202, "Spur Reduction button status", "Reads or sets the Spur Reduction button status", CAT_MISC      , CMD_CAT_TOGGLE  , "ZZSR", NULL  ,  1,     0,     1 },
    { 1203, "ZZSS", NULL, CAT_MISC      , CMD_CAT_BUTTON  , "ZZSS", NULL  ,  0,     0,     0 },
    { 1204, "Current console step size (read-...", "Reads the current console step size (read-only property)", CAT_MISC      , CMD_CAT_BUTTON  , "ZZST", NULL  ,  0,     0,     0 },
    { 1205, "RX2 Squelch button", "Sets or reads the RX2 Squelch button", CAT_MISC      , CMD_CAT_TOGGLE  , "ZZSV", NULL  ,  1,     0,     1 },
    { 1206, "CTCSS enable button", "Sets or reads the CTCSS enable button", CAT_MISC      , CMD_CAT_TOGGLE  , "ZZTA", NULL  ,  1,     0,     1 },
    { 1207, "CTCSS tone frequency", "Sets or reads the CTCSS tone frequency", CAT_MISC      , CMD_CAT_SET     , "ZZTB", NULL  ,  3,     0,   100 },
    { 1208, "Flex 5000 temperature sensor", "Reads the Flex 5000 temperature sensor", CAT_MISC      , CMD_CAT_BUTTON  , "ZZTS", NULL  ,  0,     0,     0 },
    { 1209, "TUN button on/off status", "Sets or reads the TUN button on/off status", CAT_MISC      , CMD_CAT_TOGGLE  , "ZZTU", NULL  ,  1,     0,     1 },
    { 1210, "VAC Enable checkbox (Setup Form)", "Reads or sets the VAC Enable checkbox (Setup Form)", CAT_MISC      , CMD_CAT_TOGGLE  , "ZZVA", NULL  ,  1,     0,     1 },
    { 1211, "ZZUP", NULL, CAT_MISC      , CMD_CAT_TOGGLE  , "ZZUP", NULL  ,  1,     0,     1 },
    { 1212, "ZZUS", NULL, CAT_MISC      , CMD_CAT_BUTTON  , "ZZUS", NULL  ,  0,     0,     0 },
    { 1213, "ZZUT", NULL, CAT_MISC      , CMD_CAT_TOGGLE  , "ZZUT", NULL  ,  1,     0,     1 },
    { 1214, "VAC Sample Rate", "Sets or reads the VAC Sample Rate", CAT_MISC      , CMD_CAT_SET     , "ZZVD", NULL  ,  3,     0,   100 },
    { 1215, "Quick Play button status // DH1KLM", "Reads or sets the Quick Play button status // DH1KLM", CAT_MISC      , CMD_CAT_TOGGLE  , "ZZQA", NULL  ,  1,     0,     1 },
    { 1216, "Quick Rec button status // DH1KLM", "Reads or sets the Quick Rec button status // DH1KLM", CAT_MISC      , CMD_CAT_TOGGLE  , "ZZQB", NULL  ,  1,     0,     1 },
    { 1217, "VAC Stereo checkbox", "Sets or reads the VAC Stereo checkbox", CAT_MISC      , CMD_CAT_TOGGLE  , "ZZVF", NULL  ,  1,     0,     1 },
    { 1218, "I/Q to VAC checkbox on the setup...", "Reads or sets the I/Q to VAC checkbox on the setup form", CAT_MISC      , CMD_CAT_TOGGLE  , "ZZVH", NULL  ,  1,     0,     1 },
    { 1219, "VAC Input cable", "Reads or sets the VAC Input cable", CAT_MISC      , CMD_CAT_SET     , "ZZVI", NULL  ,  3,     0,   100 },
    { 1220, "Direct I/Q Use RX2 checkbox", "Reads or sets the Direct I/Q Use RX2 checkbox", CAT_MISC      , CMD_CAT_TOGGLE  , "ZZVJ", NULL  ,  1,     0,     1 },
    { 1221, "VAC2 Enable checkbox (Setup Form)", "Reads or sets the VAC2 Enable checkbox (Setup Form)", CAT_MISC      , CMD_CAT_TOGGLE  , "ZZVK", NULL  ,  1,     0,     1 },
    { 1222, "VAC Driver", "Reads or sets the VAC Driver", CAT_MISC      , CMD_CAT_SET     , "ZZVM", NULL  ,  3,     0,   100 },
    { 1223, "Returns the version number of th...", "Returns the version number of the PowerSDR program", CAT_MISC      , CMD_CAT_BUTTON  , "ZZVN", NULL  ,  0,     0,     0 },
    { 1224, "VAC Output cable", "Reads or sets the VAC Output cable", CAT_MISC      , CMD_CAT_SET     , "ZZVO", NULL  ,  3,     0,   100 },
    { 1225, "VAC1 IQ Calibrate checkbox on th...", "Reads or sets the VAC1 IQ Calibrate checkbox on the setup form", CAT_MISC      , CMD_CAT_TOGGLE  , "ZZVP", NULL  ,  1,     0,     1 },
    { 1226, "VAC2 Driver", "Reads or sets the VAC2 Driver", CAT_MISC      , CMD_CAT_SET     , "ZZVQ", NULL  ,  3,     0,   100 },
    { 1227, "VAC2 Input cable", "Reads or sets the VAC2 Input cable", CAT_MISC      , CMD_CAT_SET     , "ZZVR", NULL  ,  3,     0,   100 },
    { 1228, "VAC2 Output cable", "Reads or sets the VAC2 Output cable", CAT_MISC      , CMD_CAT_SET     , "ZZVT", NULL  ,  3,     0,   100 },
    { 1229, "VAC2 Sample Rate", "Sets or reads the VAC2 Sample Rate", CAT_MISC      , CMD_CAT_SET     , "ZZVU", NULL  ,  3,     0,   100 },
    { 1230, "VAC2 Stereo checkbox", "Sets or reads the VAC2 Stereo checkbox", CAT_MISC      , CMD_CAT_TOGGLE  , "ZZVV", NULL  ,  1,     0,     1 },
    { 1231, "ZZVW", NULL, CAT_MISC      , CMD_CAT_SET     , "ZZVW", NULL  ,  2,   -40,    40 },
    { 1232, "VAC1 Buffer Size", "Sets or reads the VAC1 Buffer Size", CAT_MISC      , CMD_CAT_SET     , "ZZVY", NULL  ,  3,     0,   100 },
    { 1233, "VAC1 Buffer Size", "Sets or reads the VAC1 Buffer Size", CAT_MISC      , CMD_CAT_SET     , "ZZVZ", NULL  ,  3,     0,   100 },
    { 1234, "F5K Line In RCA level", "Sets or reads the F5K Line In RCA level", CAT_MISC      , CMD_CAT_SET     , "ZZWB", NULL  ,  3,     0,   100 },
    { 1235, "F5K Line In Phono level", "Sets or reads the F5K Line In Phono level", CAT_MISC      , CMD_CAT_SET     , "ZZWC", NULL  ,  3,     0,   100 },
    { 1236, "F5K Mixer Line In DB9 level", "Sets or reads the F5K Mixer Line In DB9 level", CAT_MISC      , CMD_CAT_SET     , "ZZWD", NULL  ,  3,     0,   100 },
    { 1237, "F5K Mixer Line In RCA Checkbox", "Sets or reads the F5K Mixer Line In RCA Checkbox", CAT_MISC      , CMD_CAT_SET     , "ZZWF", NULL  ,  3,     0,   100 },
    { 1238, "F5K Mixer Line In Phono Checkbox", "Sets or reads the F5K Mixer Line In Phono Checkbox", CAT_MISC      , CMD_CAT_SET     , "ZZWG", NULL  ,  3,     0,   100 },
    { 1239, "F1500/F5K Mixer Line In FlexWire...", "Sets or reads the F1500/F5K Mixer Line In FlexWire/DB9 Checkbox", CAT_MISC      , CMD_CAT_SET     , "ZZWH", NULL  ,  3,     0,   100 },
    { 1240, "F5K Mixer Internal Speaker level", "Sets or reads the F5K Mixer Internal Speaker level", CAT_MISC      , CMD_CAT_SET     , "ZZWK", NULL  ,  3,     0,   100 },
    { 1241, "F5K Mixer External Speaker level", "Sets or reads the F5K Mixer External Speaker level", CAT_MISC      , CMD_CAT_SET     , "ZZWL", NULL  ,  3,     0,   100 },
    { 1242, "F5K Mixer Headphone level", "Sets or reads the F5K Mixer Headphone level", CAT_MISC      , CMD_CAT_SET     , "ZZWM", NULL  ,  3,     0,   100 },
    { 1243, "F5K Mixer Line Out RCA level", "Sets or reads the F5K Mixer Line Out RCA level", CAT_MISC      , CMD_CAT_SET     , "ZZWN", NULL  ,  3,     0,   100 },
    { 1244, "F5KC Mixer Internal Speaker Sele...", "Sets or reads the F5KC Mixer Internal Speaker Selected Checkbox", CAT_MISC      , CMD_CAT_SET     , "ZZWO", NULL  ,  3,     0,   100 },
    { 1245, "F5K Mixer External Speaker Selec...", "Sets or reads the F5K Mixer External Speaker Selected Checkbox", CAT_MISC      , CMD_CAT_SET     , "ZZWP", NULL  ,  3,     0,   100 },
    { 1246, "F1500F5K Mixer Headphone Selecte...", "Sets or reads the F1500F5K Mixer Headphone Selected Checkbox", CAT_MISC      , CMD_CAT_SET     , "ZZWQ", NULL  ,  3,     0,   100 },
    { 1247, "F1500 FlexWire Out/F5K Mixer Lin...", "Sets or reads the F1500 FlexWire Out/F5K Mixer Line Out RCA Selected Checkbox", CAT_MISC      , CMD_CAT_SET     , "ZZWR", NULL  ,  3,     0,   100 },
    { 1248, "F1500 Mixer Form FireWire Input ...", "Reads or sets the F1500 Mixer Form FireWire Input Level", CAT_MISC      , CMD_CAT_SET     , "ZZWU", NULL  ,  3,     0,   100 },
    { 1249, "Sets ir reads the F1500 Mixer Fo...", "Sets ir reads the F1500 Mixer Form Phones level", CAT_MISC      , CMD_CAT_SET     , "ZZWV", NULL  ,  3,     0,   100 },
    { 1250, "F1500 Mixer Form FlexWire Out level", "Sets or reads the F1500 Mixer Form FlexWire Out level", CAT_MISC      , CMD_CAT_SET     , "ZZWW", NULL  ,  3,     0,   100 },
    { 1251, "Reads RX1 combined status", NULL, CAT_MISC      , CMD_CAT_SET     , "ZZXN", NULL  ,  3,     0,   100 },
    { 1252, "Reads RX2 combined status", NULL, CAT_MISC      , CMD_CAT_SET     , "ZZXO", NULL  ,  3,     0,   100 },
    { 1253, "X2TR button status", "Sets or reads the X2TR button status", CAT_MISC      , CMD_CAT_TOGGLE  , "ZZXT", NULL  ,  1,     0,     1 },
    { 1254, "VAC2 Direct I/Q checkbox on the ...", "Reads or sets the VAC2 Direct I/Q checkbox on the setup form", CAT_MISC      , CMD_CAT_TOGGLE  , "ZZYA", NULL  ,  1,     0,     1 },
    { 1255, "VAC2 IQ Calibrate checkbox on th...", "Reads or sets the VAC2 IQ Calibrate checkbox on the setup form", CAT_MISC      , CMD_CAT_TOGGLE  , "ZZYB", NULL  ,  1,     0,     1 },
    { 1256, "ZZZB", NULL, CAT_MISC      , CMD_CAT_BUTTON  , "ZZZB", NULL  ,  0,     0,     0 },
    { 1257, "ZZZZ", NULL, CAT_MISC      , CMD_CAT_BUTTON  , "ZZZZ", NULL  ,  0,     0,     0 },
    { 1258, "ZZZQ", NULL, CAT_MISC      , CMD_CAT_TOGGLE  , "ZZZQ", NULL  ,  1,     0,     1 },
    { 1259, "ZZZR", NULL, CAT_MISC      , CMD_CAT_TOGGLE  , "ZZZR", NULL  ,  1,     0,     1 },
    { 1260, "Hardware model string", "hardware model string", CAT_MISC      , CMD_CAT_SET     , "ZZZM", NULL  ,  3,     0,   100 },
    { 1261, "Hardware version title string", "hardware version title string", CAT_MISC      , CMD_CAT_SET     , "ZZZV", NULL  ,  3,     0,   100 },
    { 1262, "ZZXA", NULL, CAT_MISC      , CMD_CAT_TOGGLE  , "ZZXA", NULL  ,  1,     0,     1 },
};
